
&mdss_mdp {
	dsi_n16t_36_0f_0b_dsc_vid: qcom,mdss_dsi_n16t_36_0f_0b_dsc_vid {
		qcom,mdss-dsi-panel-name = "xiaomi 36 0f 0b video mode dsc dsi panel";
		qcom,mdss-dsi-panel-type = "dsi_video_mode";
		qcom,mdss-dsi-virtual-channel-id = <0>;
		qcom,mdss-dsi-stream = <0>;
		qcom,mdss-dsi-bpp = <30>;
		qcom,mdss-dsi-color-order = "rgb_swap_rgb";
		qcom,mdss-dsi-underflow-color = <0xff>;
		qcom,mdss-dsi-border-color = <0>;
		qcom,dsi-ctrl-num = <0>;
		qcom,dsi-phy-num = <0>;
		qcom,mdss-dsi-traffic-mode = "burst_mode";
		qcom,mdss-dsi-lane-map = "lane_map_0123";
		qcom,mdss-dsi-bllp-eof-power-mode;
		qcom,mdss-dsi-bllp-power-mode;
		qcom,mdss-dsi-lane-0-state;
		qcom,mdss-dsi-lane-1-state;
		qcom,mdss-dsi-lane-2-state;
		qcom,mdss-dsi-lane-3-state;
		qcom,mdss-dsi-dma-trigger = "trigger_sw";
		qcom,mdss-dsi-mdp-trigger = "none";
		qcom,mdss-dsi-reset-sequence = <1 5>, <0 5>, <1 45>;
		qcom,mdss-pan-physical-width-dimension = <695>;
		qcom,mdss-pan-physical-height-dimension = <1545>;
		qcom,mdss-dsi-tx-eot-append;
		qcom,mdss-dsi-lp11-init;
		qcom,mdss-dsi-bl-inverted-dbv;
		qcom,bl-update-flag = "delay_until_first_frame";
		qcom,mdss-dsi-pan-enable-dynamic-fps;
		qcom,mdss-dsi-pan-fps-update = "dfps_immediate_porch_mode_vfp";
		qcom,dsi-supported-dfps-list = <60 120 90 30>;
		qcom,mdss-dsi-panel-dimming-enabled;

		qcom,mdss-dsi-panel-hdr-enabled;
		qcom,mdss-dsi-panel-hdr-color-primaries = <15635 16450 34000
			16000 13250 34500 7500 3000>;
		qcom,mdss-dsi-panel-peak-brightness = <9000000>;
		qcom,mdss-dsi-panel-blackness-level = <50>;

		qcom,mdss-dsi-display-timings {
			timing@0{
				qcom,mdss-dsi-video-mode;
				qcom,mdss-dsi-panel-framerate = <120>;
				qcom,mdss-dsi-panel-width = <1220>;
				qcom,mdss-dsi-panel-height = <2712>;
				qcom,mdss-dsi-h-front-porch = <46>;
				qcom,mdss-dsi-h-back-porch = <28>;
				qcom,mdss-dsi-h-pulse-width = <20>;
				qcom,mdss-dsi-h-sync-skew = <0>;
				qcom,mdss-dsi-v-back-porch = <44>;
				qcom,mdss-dsi-v-front-porch = <56>;
				qcom,mdss-dsi-v-pulse-width = <4>;
				qcom,mdss-dsi-h-sync-pulse = <0>;
				qcom,mdss-dsi-h-left-border = <0>;
				qcom,mdss-dsi-h-right-border = <0>;
				qcom,mdss-dsi-v-top-border = <0>;
				qcom,mdss-dsi-v-bottom-border = <0>;

				qcom,mdss-dsi-on-command = [
					/* Frame Rate 120Hz */
					15 00 00 40 00 00 02 48 03
					/* DBV Change */
					39 00 00 40 00 00 03 51 00 00
					/* Write Control Display */
					15 00 00 40 00 00 02 53 E0
					/* TE as V-Sync */
					15 00 00 00 00 00 02 35 00
					/* Update Key - Unlock */
					39 00 00 40 00 00 03 9C A5 A5
					39 00 00 00 00 00 03 FD 5A 5A
					/* OSC 127MHz*/
					15 00 00 40 00 00 02 9F 0F
					15 00 00 40 00 00 02 D7 33
					/* Group 2 and Group 4 Reload Disable */
					39 00 00 00 00 00 0A B3 02 00 00 00 00 00 00 FF EB
					/* Display Improve */
					15 00 00 40 00 00 02 9F 02
					39 00 00 40 00 00 1B B2 00 C9 32 90 10 11 18 12 10 10 78 26 11 14 13 11 11 11 11 11 11 11 21 21 11 0B
					/* Fix Screen Flicker */
					39 00 00 40 00 00 14 B6 05 40 00 11 11 11 1C 22 22 22 22 22 22 22 22 22 22 22 22
					39 00 00 40 00 00 11 B7 00 00 00 00 00 15 70 03 03 03 03 03 03 03 03 03
					/* GOA CLK Start Pos */
					39 00 00 40 00 00 1B C6 00 00 2B 00 00 11 FF 00 04 90 00 00 00 00 2B 00 11 00 00 00 00 00 55 01 01 00
					39 00 00 00 00 00 06 E1 43 00 11 60 04
					/* swire pulse in 1frame */
					15 00 00 40 00 00 02 9F 04
					39 00 00 40 00 00 25 C6 4B 00 10 00 02 D5 00 02 CB 01 10 43 01 0A 00 00 00 00 00 00 00 00 00 00 00 00 00 00 00 00 00 00 00 00 00 00
					/* AVDD 7.0V */
					39 00 00 40 00 00 05 C8 2D 2D 00 00
					/* LHBM FOD BRIGHTNESS */
					39 00 00 00 00 00 0F BE 00 00 2A 2F 06 A7 15 9A 7C EA 04 00 D2 00
					/* Sleep Out */
					05 00 00 00 78 00 01 11
					/* Error Flag: Low to High*/
					15 00 00 40 00 00 02 9F 02
					39 00 00 40 00 00 04 ED 00 01 80
					39 00 00 00 00 00 12 EE 05 00 00 00 00 88 00 00 00 30 88 88 29 00 00 00 00
					/* HSYNC Compensation */
					15 00 00 40 00 00 02 9F 01
					39 00 00 40 00 00 05 B4 10 00 00 03
					/* MIPI EQ */
					39 00 00 40 00 00 03 E2 46 20
					/* Rterm CLK in */
					39 00 00 00 00 00 09 E4 00 00 80 0C FF 0F 08 00
					/* RN colorshift in 02-22 */
					15 00 00 40 00 00 02 9F 0B
					39 00 00 00 00 00 12 BE 32 00 00 00 00 00 26 26 20 62 3B 00 00 00 00 26 26
					/* exit LHBM Flicker in 03-18 */
					15 00 00 40 00 00 02 9F 05
					15 00 00 00 00 00 02 B3 20
					/* DSC Setting Ver1.2 10bpp-8bpp */
					15 00 00 40 00 00 02 9F 03
					39 00 00 40 00 00 21 B2 12 00 00 AB 30 80 0A 98 04 C4 00 0C 02 62 02 62 02 00 02 32 00 20 01 31 00 08 00 0C 08 BB 07 7B
					39 00 00 40 00 00 21 B3 18 00 10 F0 07 10 20 00 06 0F 0F 33 0E 1C 2A 38 46 54 62 69 70 77 79 7B 7D 7E 02 02 22 00 2A 40
					39 00 00 00 00 00 1F B4 2A BE 3A FC 3A FA 3A F8 3B 38 3B 78 3B B6 4B B6 4B F4 4B F4 6C 34 84 74 00 00 00 00 00 00
					/* Update Key - Lock */
					39 00 00 40 00 00 03 9C 5A 5A
					39 00 00 00 00 00 03 FD A5 A5
					/* Display On */
					05 00 00 00 00 00 01 29
				];
				qcom,mdss-dsi-on-command-state = "dsi_hs_mode";

				qcom,mdss-dsi-off-command = [
					05 00 00 00 00 00 01 28
					05 00 00 00 78 00 01 10
				];
				qcom,mdss-dsi-off-command-state = "dsi_hs_mode";

				qcom,compression-mode = "dsc";
				qcom,mdss-dsc-version = <0x12>;
				qcom,mdss-dsc-scr-version = <0x0>;
				qcom,mdss-dsc-slice-height = <12>;
				qcom,mdss-dsc-slice-width = <610>;
				qcom,mdss-dsc-slice-per-pkt = <2>;
				qcom,mdss-dsc-bit-per-component = <10>;
				qcom,mdss-dsc-bit-per-pixel = <8>;
				qcom,mdss-dsc-block-prediction-enable;
			};
		};
	};
};

&dsi_n16t_36_0f_0b_dsc_vid {
	mi,panel-id = <0x4e313654 0x00360f01>;
	mi,max-brightness-clone = <16383>;
	mi,normal-max-brightness-clone = <4095>;
	mi,mdss-dsi-fac-bl-max-level = <2167>;
	mi,mdss-fac-brightness-max-level = <2167>;
	mi,thermal-dimming-flag;
	mi,ddic-round-corner-enabled;
	mi,panel-on-dimming-delay = <120>;
	mi,flatmode-default-on-enabled;

	/* IRQF_ONESHOT | IRQF_TRIGGER_HIGH */
	mi,esd-err-irq-gpio = <&tlmm 157 0x2004>;
	mi,panel-ignore-esd-in-aod;

	/* AOD CONFIG*/
	mi,doze-hbm-dbv-level = <245>;
	mi,doze-lbm-dbv-level = <20>;

	/* FOD CONFIG */
	mi,local-hbm-enabled;
	mi,need-fod-animal-in-normal-enabled;
	mi,local-hbm-ui-ready-delay-num-frame = <3>; /* 3 frame */

	/* Cell ID */
	mi,mdss-dsi-panel-cell-id-read-command = [06 00 00 00 00 00 01 A1];
	mi,mdss-dsi-panel-cell-id-read-command-state = "dsi_hs_mode";
	mi,mdss-dsi-panel-cell-id-read-length = <16>;

	/* White Point */
	mi,mdss-dsi-panel-wp-read-command = [06 00 00 00 00 00 01 B1];
	mi,mdss-dsi-panel-wp-read-command-state = "dsi_hs_mode";
	mi,mdss-dsi-panel-wp-read-length = <3>;

	/* Flat Mode Check */
	mi,flatmode-status-check-enabled;
	mi,mdss-dsi-panel-flatmode-status-offset-command = [
		39 00 00 40 00 00 03 9C A5 A5
		39 00 00 40 00 00 03 FD 5A 5A
		15 00 00 00 00 00 02 9F 08
	];
	mi,mdss-dsi-panel-flatmode-status-command = [
		06 00 00 00 00 00 01 B2
	];
	mi,mdss-dsi-panel-flatmode-status-command-state = "dsi_hs_mode";
	mi,mdss-dsi-panel-flatmode-status-read-length = <1>;
	mi,mdss-dsi-panel-flatmode-on-status-value = <0x12>;

	qcom,mdss-dsi-display-timings {
		timing@0{
			/* Flat Mode Setting */
			mi,mdss-dsi-flat-mode-on-command = [
				39 00 00 40 00 00 03 9C A5 A5
				39 00 00 40 00 00 03 FD 5A 5A
				15 00 00 40 00 00 02 9F 08
				15 00 00 40 00 00 02 B2 12
				39 00 00 40 00 00 03 9C 5A 5A
				39 00 00 00 00 00 03 FD A5 A5
			];
			mi,mdss-dsi-flat-mode-on-command-state = "dsi_hs_mode";

			mi,mdss-dsi-flat-mode-off-command = [
				39 00 00 40 00 00 03 9C A5 A5
				39 00 00 40 00 00 03 FD 5A 5A
				15 00 00 40 00 00 02 9F 08
				15 00 00 40 00 00 02 B2 10
				39 00 00 40 00 00 03 9C 5A 5A
				39 00 00 00 00 00 03 FD A5 A5
			];
			mi,mdss-dsi-flat-mode-off-command-state = "dsi_hs_mode";

			/* APB Mode Setting */
			mi,mdss-dsi-apb-mode-on-command = [
				15 00 00 40 00 00 02 48 33    /* HF3 60HZ*/
				39 00 00 40 00 00 03 51 0F FF
				39 00 00 40 00 00 03 9C A5 A5
				39 00 00 40 00 00 03 FD 5A 5A
				15 00 00 40 00 00 02 9F 08
				15 00 00 40 00 00 02 B2 12
				39 00 00 40 00 00 04 CC 03 FF 3C
				39 00 00 40 00 00 03 9C 5A 5A
				39 00 00 00 00 00 03 FD A5 A5
			];
			mi,mdss-dsi-apb-mode-on-command-state = "dsi_hs_mode";

			mi,mdss-dsi-apb-mode-off-command = [
				39 00 00 40 00 00 03 9C A5 A5
				39 00 00 40 00 00 03 FD 5A 5A
				15 00 00 40 00 00 02 9F 08
				39 00 00 40 00 00 04 CC 02 FF 3C
				39 00 00 40 00 00 03 9C 5A 5A
				39 00 00 00 00 00 03 FD A5 A5
				15 00 00 00 00 00 02 48 23    /*60HZ*/
			];
			mi,mdss-dsi-apb-mode-off-command-state = "dsi_hs_mode";

			/* FPS Switch Setting */
			mi,mdss-dsi-fps-120-gamma-command = [
				15 00 00 00 00 00 02 48 03
			];
			mi,mdss-dsi-fps-120-gamma-command-state = "dsi_hs_mode";

			mi,mdss-dsi-fps-90-gamma-command = [
				15 00 00 00 00 00 02 48 13
			];
			mi,mdss-dsi-fps-90-gamma-command-state = "dsi_hs_mode";

			mi,mdss-dsi-fps-60-gamma-command = [
				15 00 00 00 00 00 02 48 23
			];
			mi,mdss-dsi-fps-60-gamma-command-state = "dsi_hs_mode";

			/* Round Corner Setting */
			mi,mdss-dsi-round-corner-on-command = [
				39 00 00 40 00 00 03 9C A5 A5
				39 00 00 40 00 00 03 FD 5A 5A
				15 00 00 40 00 00 02 9F 0B
				15 00 00 40 00 00 02 B2 01
				39 00 00 40 00 00 03 9C 5A 5A
				39 00 00 00 00 00 03 FD A5 A5
			];
			mi,mdss-dsi-round-corner-on-command-state = "dsi_hs_mode";

			mi,mdss-dsi-round-corner-off-command = [
				39 00 00 40 00 00 03 9C A5 A5
				39 00 00 40 00 00 03 FD 5A 5A
				15 00 00 40 00 00 02 9F 0B
				15 00 00 40 00 00 02 B2 00
				39 00 00 40 00 00 03 9C 5A 5A
				39 00 00 00 00 00 03 FD A5 A5
			];
			mi,mdss-dsi-round-corner-off-command-state = "dsi_hs_mode";

			/* LHBM Setting */
			mi,mdss-dsi-local-hbm-normal-white-1000nit-command = [
				39 00 00 00 00 00 05 97 11 AF FF 00
			];
			mi,mdss-dsi-local-hbm-normal-white-1000nit-command-state = "dsi_hs_mode";
			mi,mdss-dsi-local-hbm-normal-white-1000nit-command-update = <0x97 0 4>;

			mi,mdss-dsi-local-hbm-normal-white-110nit-command = [
				39 00 00 00 00 00 05 97 11 AF FF 01
			];
			mi,mdss-dsi-local-hbm-normal-white-110nit-command-state = "dsi_hs_mode";
			mi,mdss-dsi-local-hbm-normal-white-110nit-command-update = <0x97 0 4>;

			mi,mdss-dsi-local-hbm-normal-green-500nit-command = [
				39 00 00 00 00 00 05 97 11 AF FF 02
			];
			mi,mdss-dsi-local-hbm-normal-green-500nit-command-state = "dsi_hs_mode";
			mi,mdss-dsi-local-hbm-normal-green-500nit-command-update = <0x97 0 4>;

			mi,mdss-dsi-local-hbm-off-to-normal-command = [
				39 00 00 00 00 00 04 97 00 0F FF
			];
			mi,mdss-dsi-local-hbm-off-to-normal-command-state = "dsi_hs_mode";

			mi,mdss-dsi-local-hbm-hlpm-white-1000nit-command = [
				39 00 00 00 00 00 05 97 11 AF FF 00
			];
			mi,mdss-dsi-local-hbm-hlpm-white-1000nit-command-update = <0x97 0 4>;
			mi,mdss-dsi-local-hbm-hlpm-white-1000nit-command-state = "dsi_hs_mode";

			mi,mdss-dsi-local-hbm-hlpm-white-110nit-command = [
				39 00 00 00 00 00 05 97 11 AF FF 01
			];
			mi,mdss-dsi-local-hbm-hlpm-white-110nit-command-update = <0x97 0 4>;
			mi,mdss-dsi-local-hbm-hlpm-white-110nit-command-state = "dsi_hs_mode";

			mi,mdss-dsi-local-hbm-off-to-hbm-command = [
				39 00 00 00 00 00 04 97 00 0F FF
			];
			mi,mdss-dsi-local-hbm-off-to-hbm-command-state = "dsi_hs_mode";

			/* AOD Setting */
			mi,mdss-dsi-doze-hbm-command = [
				39 00 00 00 00 00 03 51 03 FF
			];
			mi,mdss-dsi-doze-hbm-command-update = <0x51 0 2>;
			mi,mdss-dsi-doze-hbm-command-state = "dsi_hs_mode";

			mi,mdss-dsi-doze-lbm-command = [
				39 00 00 00 00 00 03 51 01 FF
			];
			mi,mdss-dsi-doze-lbm-command-update = <0x51 0 2>;
			mi,mdss-dsi-doze-lbm-command-state = "dsi_hs_mode";

			mi,mdss-dsi-doze-hbm-nolp-command = [
				39 00 00 00 00 00 03 51 00 F5
			];
			mi,mdss-dsi-doze-hbm-nolp-command-update = <0x51 0 2>;
			mi,mdss-dsi-doze-hbm-nolp-command-state = "dsi_hs_mode";

			mi,mdss-dsi-doze-lbm-nolp-command = [
				39 00 00 00 00 00 03 51 00 14
			];
			mi,mdss-dsi-doze-lbm-nolp-command-update = <0x51 0 2>;
			mi,mdss-dsi-doze-lbm-nolp-command-state = "dsi_hs_mode";

			qcom,mdss-dsi-nolp-command = [
				39 00 00 00 00 00 03 51 00 00
			];
			qcom,mdss-dsi-nolp-command-update = <0x51 0 2>;
			qcom,mdss-dsi-nolp-command-state = "dsi_hs_mode";

			mi,mdss-dsi-aod-enter-command = [
				15 00 00 40 00 00 02 90 01
				39 00 00 00 00 00 03 51 03 FF
			];
			mi,mdss-dsi-aod-enter-command-update = <0x51 1 2>;
			mi,mdss-dsi-aod-enter-command-state = "dsi_hs_mode";

			mi,mdss-dsi-aod-exit-command = [
				39 00 00 40 00 00 03 51 00 F5
				15 00 00 40 00 00 02 90 00
				15 00 00 40 00 00 02 48 23
				39 00 00 40 00 00 03 9C A5 A5
				39 00 00 40 00 00 03 FD 5A 5A
				15 00 00 40 00 00 02 9F 01
				15 00 00 40 00 00 02 CD 00
				39 00 00 40 00 00 03 9C 5A 5A
				39 00 00 00 00 00 03 FD A5 A5
				39 00 00 40 21 00 03 9C A5 A5
				39 00 00 40 00 00 03 FD 5A 5A
				15 00 00 40 00 00 02 9F 01
				15 00 00 40 00 00 02 CD 06
				39 00 00 40 00 00 03 9C 5A 5A
				39 00 00 00 00 00 03 FD A5 A5
			];
			mi,mdss-dsi-aod-exit-command-update = <0x51 0 2>, <0x48 2 1>;
			mi,mdss-dsi-aod-exit-command-state = "dsi_hs_mode";
		};
	};
};
