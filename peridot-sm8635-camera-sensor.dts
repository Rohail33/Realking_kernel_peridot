/dts-v1/;
/plugin/;

#include <dt-bindings/clock/qcom,gcc-cliffs.h>
#include <dt-bindings/clock/qcom,camcc-cliffs.h>
#include <dt-bindings/interconnect/qcom,cliffs.h>
#include <dt-bindings/interrupt-controller/arm-gic.h>
#include <dt-bindings/regulator/qcom,rpmh-regulator-levels.h>

#include "peridot-sm8635-camera-sensor.dtsi"
/ {
	model = "Qualcomm Technologies, Inc. Cliffs MTP";
	compatible = "qcom,cliffs-mtp", "qcom,cliffs", "qcom,mtp";
	qcom,msm-id = <614 0x10000>, <632 0x10000>;
	qcom,board-id = <8 0>, <8 1>;
	xiaomi,miboard-id = <0x8 0>;
};
